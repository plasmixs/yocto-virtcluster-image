## meta-armvm/conf/layer.conf
```bitbake
# We have a conf and classes directory, add to BBPATH
BBPATH .= ":${LAYERDIR}"

# We have a recipes-* directories, add to BBFILES
BBFILES += "${LAYERDIR}/recipes-*/*/*.bb \
	${LAYERDIR}/recipes-*/*/*.bbappend"

BBFILE_COLLECTIONS += "armvm"
BBFILE_PATTERN_armvm = "^${LAYERDIR}/"
BBFILE_PRIORITY_armvm = "6"
```

## meta-armvm/conf/machine/armvm.conf
```bitbake
#@TYPE: Machine
#@NAME: armvm

#@DESCRIPTION: Machine configuration for armvm systems


PREFERRED_PROVIDER_virtual/kernel ?= "linux-yocto"
PREFERRED_VERSION_linux-yocto ?= "3.10%"


require conf/machine/include/qemu.inc
require conf/machine/include/tune-arm926ejs.inc


KERNEL_IMAGETYPE = "zImage"
SERIAL_CONSOLE = "115200 ttyAMA0"
```

## meta-bb/conf/layer.conf
```bitbake
# We have a conf and classes directory, add to BBPATH
BBPATH .= ":${LAYERDIR}"

# We have a recipes-* directories, add to BBFILES
BBFILES += "${LAYERDIR}/recipes-*/*/*.bb \
	${LAYERDIR}/recipes-*/*/*.bbappend"

BBFILE_COLLECTIONS += "bb"
BBFILE_PATTERN_bb = "^${LAYERDIR}/"
BBFILE_PRIORITY_bb = "6"
```

## meta-virtcluster/conf/distro/virtcluster.conf
```bitbake
#Use distro feature defined in poky distro.
require conf/distro/defaultsetup.conf

DISTRO = "virtcluster"
DISTRO_NAME = "virtcluster-os"
DISTRO_VERSION = "1.0.0"
```

## meta-x86vm/conf/machine/x86vm.conf
```bitbake
#@TYPE: Machine
#@NAME: x86vm

#@DESCRIPTION: Machine configuration for x86vm systems


PREFERRED_PROVIDER_virtual/kernel ?= "linux-yocto"
PREFERRED_VERSION_linux-yocto ?= "3.10%"

PREFERRED_PROVIDER_virtual/xserver ?= "xserver-xorg"
PREFERRED_PROVIDER_virtual/libgl ?= "mesa"
PREFERRED_PROVIDER_virtual/libgles1 ?= "mesa"
PREFERRED_PROVIDER_virtual/libgles2 ?= "mesa"

require conf/machine/include/qemu.inc
require conf/machine/include/tune-i586.inc

MACHINE_FEATURES += "x86 acpi"
KERNEL_IMAGETYPE = "bzImage"
SERIAL_CONSOLE = "115200 ttyS0"
XSERVER = "xserver-xorg \
           ${@base_contains('DISTRO_FEATURES', 'opengl', 'mesa-driver-swrast', '', d)} \
           xf86-input-vmmouse \
           xf86-input-keyboard \
           xf86-input-evdev \
           xf86-video-vmware"
```
